#include "sh1106.h"
#include "stm32f4xx_hal.h"
#include <stddef.h>

/* Handle I2C dari CubeMX (default hi2c1, global di main.c). */
extern I2C_HandleTypeDef SH1106_HI2C;

#define SH1106_TIMEOUT 100U

/* Framebuffer: 8 halaman x 128 kolom. 1 byte = 8 piksel vertikal,
 * bit 0 = piksel paling atas dalam halaman. */
static uint8_t s_fb[8][SH1106_WIDTH];
static uint8_t s_addr7 = SH1106_I2C_ADDR;

/* ============================================================
 * Font 6x8 (ASCII 32..126). 6 byte/glyph = 6 kolom, bit 0 = baris atas.
 * Di-generate oleh Tools/gen_font.py (Consolas, supersampled).
 * ============================================================ */
static const uint8_t FONT6x8[95][6] = {
    {0x00, 0x00, 0x00, 0x00, 0x00, 0x00}, /*  32 ' ' */
    {0x00, 0x00, 0x9F, 0x00, 0x00, 0x00}, /*  33 '!' */
    {0x3C, 0x3C, 0x00, 0x00, 0x3C, 0x3C}, /*  34 '\"' */
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    {0x18, 0x08, 0x08, 0x10, 0x10, 0x18}, /* 126 '~' */
};

/* ============================================================
 * I2C low-level
 * ============================================================ */
static void write_cmd(uint8_t cmd)
{
    /* control byte 0x00 = perintah */
    HAL_I2C_Mem_Write(&SH1106_HI2C, (uint16_t)(s_addr7 << 1), 0x00,
                      I2C_MEMADD_SIZE_8BIT, &cmd, 1, SH1106_TIMEOUT);
}

static void write_data(const uint8_t *data, uint16_t len)
{
    /* control byte 0x40 = data */
    HAL_I2C_Mem_Write(&SH1106_HI2C, (uint16_t)(s_addr7 << 1), 0x40,
                      I2C_MEMADD_SIZE_8BIT, (uint8_t *)data, len, SH1106_TIMEOUT);
}

/* ============================================================
 * Init
 * ============================================================ */
void SH1106_Init(void)
{
    /* Jika gambar terbalik/mirror, tukar 0xA1<->0xA0 dan 0xC8<->0xC0. */
    static const uint8_t init[] = {
        0xAE,          /* display off                  */
        0xD5, 0x80,    /* clock divide ratio           */
        0xA8, 0x3F,    /* multiplex ratio = 64         */
        0xD3, 0x00,    /* display offset = 0           */
        0x40,          /* start line = 0               */
        0xAD, 0x8B,    /* charge pump ON (khas SH1106) */
        0xA1,          /* segment remap                */
        0xC8,          /* COM scan direction remapped  */
        0xDA, 0x12,    /* COM pins hardware config     */
        0x81, 0xCF,    /* contrast                     */
        0xD9, 0x22,    /* pre-charge period            */
        0xDB, 0x35,    /* VCOM deselect level          */
        0xA4,          /* resume dari all-on           */
        0xA6,          /* normal (bukan invert)        */
        0xAF           /* display on                   */
    };
    for (size_t i = 0; i < sizeof(init) / sizeof(init[0]); i++) {
        write_cmd(init[i]);
    }
    SH1106_Clear();
    SH1106_Update();
}

void SH1106_Clear(void)
{
    for (int p = 0; p < 8; p++) {
        for (int x = 0; x < SH1106_WIDTH; x++) {
            s_fb[p][x] = 0x00;
        }
    }
}

void SH1106_Update(void)
{
    for (uint8_t page = 0; page < 8; page++) {
        write_cmd((uint8_t)(0xB0 | page));  /* set page address        */
        write_cmd(0x02);                    /* kolom bawah = 2         */
        write_cmd(0x10);                    /* kolom atas  = 0         */
        write_data(s_fb[page], SH1106_WIDTH);
    }
}

bool SH1106_Probe(uint8_t addr7)
{
    return HAL_I2C_IsDeviceReady(&SH1106_HI2C, (uint16_t)(addr7 << 1), 2, 10)
           == HAL_OK;
}

void SH1106_SetAddress(uint8_t addr7)
{
    s_addr7 = addr7;
}

/* ============================================================
 * Drawing
 * ============================================================ */
void SH1106_SetPixel(int x, int y, bool on)
{
    if (x < 0 || x >= SH1106_WIDTH || y < 0 || y >= SH1106_HEIGHT) return;
    uint8_t page = (uint8_t)(y >> 3);
    uint8_t bit  = (uint8_t)(1U << (y & 7));
    if (on) s_fb[page][x] |=  bit;
    else    s_fb[page][x] &= (uint8_t)~bit;
}

void SH1106_DrawLine(int x0, int y0, int x1, int y1, bool on)
{
    int dx = x1 > x0 ? x1 - x0 : x0 - x1;
    int dy = y1 > y0 ? y1 - y0 : y0 - y1;
    int sx = x0 < x1 ? 1 : -1;
    int sy = y0 < y1 ? 1 : -1;
    int err = dx - dy;

    for (;;) {
        SH1106_SetPixel(x0, y0, on);
        if (x0 == x1 && y0 == y1) break;
        int e2 = 2 * err;
        if (e2 > -dy) { err -= dy; x0 += sx; }
        if (e2 <  dx) { err += dx; y0 += sy; }
    }
}

void SH1106_DrawRect(int x, int y, int w, int h, bool on)
{
    SH1106_DrawLine(x,     y,     x + w - 1, y,         on);
    SH1106_DrawLine(x,     y + h - 1, x + w - 1, y + h - 1, on);
    SH1106_DrawLine(x,     y,     x,     y + h - 1, on);
    SH1106_DrawLine(x + w - 1, y, x + w - 1, y + h - 1, on);
}

void SH1106_DrawFillRect(int x, int y, int w, int h, bool on)
{
    for (int yy = y; yy < y + h; yy++) {
        SH1106_DrawLine(x, yy, x + w - 1, yy, on);
    }
}

void SH1106_DrawCircle(int cx, int cy, int r, bool on)
{
    int x = 0, y = r, d = 3 - 2 * r;
    while (y >= x) {
        SH1106_SetPixel(cx + x, cy + y, on);
        SH1106_SetPixel(cx - x, cy + y, on);
        SH1106_SetPixel(cx + x, cy - y, on);
        SH1106_SetPixel(cx - x, cy - y, on);
        SH1106_SetPixel(cx + y, cy + x, on);
        SH1106_SetPixel(cx - y, cy + x, on);
        SH1106_SetPixel(cx + y, cy - x, on);
        SH1106_SetPixel(cx - y, cy - x, on);
        if (d < 0) {
            d += 4 * x + 6;
        } else {
            d += 4 * (x - y) + 10;
            y--;
        }
        x++;
    }
}

void SH1106_DrawFillCircle(int cx, int cy, int r, bool on)
{
    for (int y = -r; y <= r; y++) {
        int half = 0;
        while ((half + 1) * (half + 1) + y * y <= r * r) half++;
        SH1106_DrawLine(cx - half, cy + y, cx + half, cy + y, on);
    }
}

void SH1106_DrawChar(int x, int y, char c)
{
    int idx = (int)c - 32;
    if (idx < 0 || idx >= 95) idx = 0;   /* karakter di luar tabel -> spasi */
    for (int col = 0; col < 6; col++) {
        uint8_t bits = FONT6x8[idx][col];
        for (int row = 0; row < 8; row++) {
            if (bits & (1U << row)) {
                SH1106_SetPixel(x + col, y + row, true);
            }
        }
    }
}

void SH1106_DrawString(int x, int y, const char *s)
{
    while (*s) {
        SH1106_DrawChar(x, y, *s++);
        x += 6;
    }
}
